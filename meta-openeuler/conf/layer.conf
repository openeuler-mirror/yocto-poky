## meta-openeuler/conf/layer.conf
```bitbake
# We have a conf and classes directory, add to BBPATH
BBPATH .= ":${LAYERDIR}"

# We have recipes-* directories, add to BBFILES
BBFILES += "${LAYERDIR}/recipes-*/*/*.bb \
            ${LAYERDIR}/recipes-*/*/*.bbappend"

BBFILE_COLLECTIONS += "openeuler-src"
BBFILE_PATTERN_openeuler-src = "^${LAYERDIR}/"
BBFILE_PRIORITY_openeuler-src = "30"
LAYERVERSION_openeuler-src = "1"
LAYERSERIES_COMPAT_openeuler-src = "hardknott"

OPENEULER_SP_DIR = "/usr1/openeuler/src"
```
